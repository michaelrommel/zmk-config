/*
*
* Copyright (c) 2023 The ZMK Contributors
* SPDX-License-Identifier: MIT
*
*/

#include "nightliner.dtsi"

/{
    kscan0: kscan {
        compatible = "zmk,kscan-gpio-matrix";

        diode-direction = "col2row";
        row-gpios
            = <&gpio1 2 (GPIO_ACTIVE_HIGH | GPIO_PULL_DOWN)>
            , <&gpio1 1 (GPIO_ACTIVE_HIGH | GPIO_PULL_DOWN)>
            , <&gpio1 3 (GPIO_ACTIVE_HIGH | GPIO_PULL_DOWN)>
            , <&gpio0 22 (GPIO_ACTIVE_HIGH | GPIO_PULL_DOWN)>
            ;

        col-gpios
            = <&gpio0  21 GPIO_ACTIVE_HIGH>
            , <&gpio0  19 GPIO_ACTIVE_HIGH>
            , <&gpio0  23 GPIO_ACTIVE_HIGH>
            , <&gpio0  12 GPIO_ACTIVE_HIGH>
			, <&gpio1  9 GPIO_ACTIVE_HIGH>
            ;
    };
};

&default_transform {
    col-offset = <5>;
};
