## boards/arm/nightliner/Kconfig.board
```kconfig
#
# Copyright (c) 2023 The ZMK Contributors
# SPDX-License-Identifier: MIT
#

config BOARD_NIGHTLINER_LEFT
    bool "nightliner_left"
    depends on SOC_NRF52840_QIAA

config BOARD_NIGHTLINER_RIGHT
    bool "nightliner_right"
    depends on SOC_NRF52840_QIAA
```

## boards/arm/nightliner/Kconfig.defconfig
```kconfig
#
# Copyright (c) 2023 The ZMK Contributors
# SPDX-License-Identifier: MIT
#

if BOARD_NIGHTLINER_LEFT

config ZMK_KEYBOARD_NAME
    default "nightliner"

config ZMK_SPLIT_ROLE_CENTRAL
    default y

endif # BOARD_NIGHTLINER_LEFT

if BOARD_NIGHTLINER_RIGHT

config ZMK_KEYBOARD_NAME
    default "nightliner right"

endif # BOARD_NIGHTLINER_RIGHT


if BOARD_NIGHTLINER_LEFT || BOARD_NIGHTLINER_RIGHT

config BOARD
    default "nightliner"

config ZMK_SPLIT
    default y

config BT_CTLR
    default BT

if USB

config USB_NRFX
    default y

config USB_DEVICE_STACK
    default y

endif # USB

endif # BOARD_NIGHTLINER_LEFT || BOARD_NIGHTLINER_RIGHT
```
